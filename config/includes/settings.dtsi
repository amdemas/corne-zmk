#define QUICK_TAP_MS 175

&mt {
    flavor = "tap-preferred";
    tapping-term-ms = <220>;
    quick-tap-ms = <220>;              // repeat on tap-into-hold
    hold-trigger-key-positions = <0>;  // tap on interrupt
};

&sk {  // sticky-key config
    release-after-ms = <600>;  // release after 0.6s
    quick-release;             // no double capitalization when rolling keys
};

&sl {  // sticky-layer config
    ignore-modifiers;
};

&lt {  // layer-tap config
    flavor = "balanced";
    tapping-term-ms = <200>;
    quick-tap-ms = <QUICK_TAP_MS>;
};
