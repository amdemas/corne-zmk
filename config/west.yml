## config/west.yml
```yaml
manifest:
  remotes:
    - name: zmkfirmware
      url-base: https://github.com/zmkfirmware
    - name: brinx
      url-base: https://github.com/birnx
  projects:
    - name: ume-config
      remote: birnx
      revision: main
      import: app/west.yml
  self:
    path: config
```
